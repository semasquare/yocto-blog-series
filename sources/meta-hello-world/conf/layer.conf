## sources/meta-hello-world/conf/layer.conf
```bitbake
BBPATH .= ":${LAYERDIR}"

BBFILES += "${LAYERDIR}/recipes-*/*/*.bb \
${LAYERDIR}/recipes-*/*/*.bbappend"

BBFILE_COLLECTIONS += "hello-world"
BBFILE_PATTERN_hello-world = "^${LAYERDIR}/"
BBFILE_PRIORITY_hello-world = "5"

LAYERSERIES_COMPAT_hello-world = "dunfell"
```
